## sdkconfig.defaults
```kconfig
#
# ESP System Settings
#
CONFIG_ESP_MAIN_TASK_STACK_SIZE=8192

#
# Partition Table
#
CONFIG_PARTITION_TABLE_CUSTOM=y
CONFIG_PARTITION_TABLE_CUSTOM_FILENAME="partitions.csv"
CONFIG_PARTITION_TABLE_FILENAME="partitions.csv"

#
# HTTP Server
#
CONFIG_HTTPD_MAX_REQ_HDR_LEN=1024
```
